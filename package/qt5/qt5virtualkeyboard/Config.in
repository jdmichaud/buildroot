## package/qt5/qt5virtualkeyboard/Config.in
```kconfig
comment "qt5virtualkeyboard needs at least qt-5.7 and qt5declarative quick module"
	depends on !BR2_PACKAGE_QT5_VERSION_LATEST || !BR2_PACKAGE_QT5DECLARATIVE_QUICK

config BR2_PACKAGE_QT5VIRTUALKEYBOARD
	bool "qt5virtualkeyboard"
	depends on BR2_PACKAGE_QT5_VERSION_LATEST
	depends on BR2_PACKAGE_QT5DECLARATIVE_QUICK
	select BR2_PACKAGE_QT5SVG
	help
	  Qt Virtual Keyboard is a virtual keyboard framework that consists of a
	  C++ backend supporting custom input methods as well as a UI frontend
	  implemented in QML.

	  This module is licensed under GPLv3.

if BR2_PACKAGE_QT5VIRTUALKEYBOARD
config BR2_PACKAGE_QT5VIRTUALKEYBOARD_LANGUAGE_LAYOUTS
	string "language layouts"
	default "en_GB"
	help
	  The Virtual Keyboard supports the following languages:
	  - Arabic (ar_AR)
	  - Danish (da_DK)
	  - English (en_GB)
	  - Finnish (fi_FI)
	  - French (fr_FR)
	  - German (de_DE)
	  - Hindi (hi_IN)
	  - Italian (it_IT)
	  - Japanese (ja_JP)
	  - Korean (ko_KR)
	  - Norwegian (nb_NO)
	  - Persian/Farsi (fa_FA)
	  - Polish (pl_PL)
	  - Portugese (pt_PT)
	  - Romanian (ro_RO)
	  - Russian (ru_RU)
	  - Simplified Chinese (zh_CN)
	  - Traditional Chinese (zh_TW)
	  - Spanish (es_ES)
	  - Swedish (sv_SE)

	  Note: all is a flag for activating all languages.

config BR2_PACKAGE_QT5VIRTUALKEYBOARD_HANDWRITING
	bool "handwriting"
	help
	  Handwriting support, with gestures for fullscreen input.

	  Lipi Toolkit (LipiTk) is an open source toolkit for online Handwriting
	  Recognition.

config BR2_PACKAGE_QT5VIRTUALKEYBOARD_HUNSPELL
	bool "hunspell"
	depends on BR2_PACKAGE_HUNSPELL
	help
	  Word reselect for Hunspell word prediction.
endif
```

## package/qt5/qt5webengine/Config.in
```kconfig
comment "qt5webengine needs an Open(E)GL-capable backend"
	depends on BR2_PACKAGE_QT5
	depends on !BR2_PACKAGE_QT5_GL_AVAILABLE || !BR2_PACKAGE_HAS_LIBEGL

config BR2_PACKAGE_QT5WEBENGINE
	bool "qt5webengine"
	depends on BR2_PACKAGE_QT5
	depends on BR2_PACKAGE_QT5_GL_AVAILABLE && BR2_PACKAGE_HAS_LIBEGL
	select BR2_PACKAGE_LIBGLIB2
	select BR2_PACKAGE_QT5BASE
	select BR2_PACKAGE_QT5BASE_DBUS
	select BR2_PACKAGE_QT5BASE_FONTCONFIG
	select BR2_PACKAGE_QT5BASE_ICU
	select BR2_PACKAGE_QT5BASE_GUI
	select BR2_PACKAGE_QT5BASE_EGLFS
	select BR2_PACKAGE_QT5BASE_WIDGETS
	select BR2_PACKAGE_QT5DECLARATIVE
	select BR2_PACKAGE_QT5DECLARATIVE_QUICK
	select BR2_PACKAGE_QT5WEBCHANNEL
	select BR2_PACKAGE_XLIB_LIBXCOMPOSITE if BR2_PACKAGE_QT5BASE_XCB
	select BR2_PACKAGE_XLIB_LIBXCURSOR if BR2_PACKAGE_QT5BASE_XCB
	select BR2_PACKAGE_XLIB_LIBXI if BR2_PACKAGE_QT5BASE_XCB
	select BR2_PACKAGE_XLIB_LIBXRANDR if BR2_PACKAGE_QT5BASE_XCB
	select BR2_PACKAGE_XLIB_LIBXSCRNSAVER if BR2_PACKAGE_QT5BASE_XCB
	select BR2_PACKAGE_XLIB_LIBXTST if BR2_PACKAGE_QT5BASE_XCB
	help
	  The Qt WebEngine module provides a web browser engine that makes it
	  easy to embed content from the World Wide Web into your Qt application
	  on platforms that do not have a native web engine.

	  Qt WebEngine provides C++ classes and QML types for rendering HTML,
	  XHTML, and SVG documents, styled using Cascading Style Sheets (CSS)
	  and scripted with JavaScript. HTML documents can be made fully
	  editable by the user through the use of the contenteditable attribute
	  on HTML elements.

if BR2_PACKAGE_QT5WEBENGINE
config BR2_PACKAGE_QT5WEBENGINE_PROPRIETARY_CODECS
	bool "proprietary codecs"
	help
	  Qt WebEngine supports the MPEG-4 Part 14 (MP4) file format; which
	  includes required proprietary audio and video codecs, such as H.264
	  and MPEG layer-3 (MP3).

config BR2_PACKAGE_QT5WEBENGINE_SYSTEM_ICU
	bool "use system icu"
	depends on BR2_PACKAGE_ICU

config BR2_PACKAGE_QT5WEBENGINE_SYSTEM_FFMPEG
	bool "use system ffmpeg"
	depends on BR2_PACKAGE_FFMPEG
endif
```

## package/webviewer/Config.in
```kconfig
config BR2_PACKAGE_WEBVIEWER
	bool "webviewer"
	depends on BR2_PACKAGE_QT5
	depends on BR2_PACKAGE_QT5WEBENGINE
	select BR2_PACKAGE_QT5WIDGETS
	help
	  A QT Web-Viewer controllable with tcp socket
```
